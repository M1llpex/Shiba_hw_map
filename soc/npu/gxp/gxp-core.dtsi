// =====================================
// File: npu/gxp/gxp-core.dtsi
// =====================================
// Google GXP DSP Core Configuration (Callisto)

/ {
	gxp: callisto@20C00000 {
		compatible = "google,gxp-zuma";
		status = "ok";
		
		/* Register Base Addresses */
		reg = <0x0 0x20C00000 0x01400000  /* AUR Core */
		       0x0 0x15320000 0x1000       /* Mailbox 0 */
		       0x0 0x15340000 0x1000       /* Mailbox 1 */
		       0x0 0x15360000 0x1000       /* Mailbox 2 */
		       0x0 0x15280000 0x1000       /* Mailbox 3 */
		       0x0 0x152A0000 0x1000       /* Mailbox 4 */
		       0x0 0x20A00000 0x1000       /* CMU AUR */
		       0x0 0x20AD0000 0x10000      /* SSMT IDMA */
		       0x0 0x20AE0000 0x10000>;    /* SSMT Inst/Data */
		
		reg-names = "aur",
			    "mailbox0", "mailbox1", "mailbox2", "mailbox3", "mailbox4",
			    "cmu", "ssmt_idma", "ssmt_inst_data";
		
		/* DMA Configuration */
		#dma-address-cells = <1>;
		#dma-size-cells = <2>;
		pasid-num-bits = <3>;
		dma-window = <0x00001000 0xF 0xFFFFF000>;
		samsung,iommu-reserved-map = <0x0 0x80000000 0x1000>;
		gcip-dma-window = <0x30000000 0x0 0xC0000000>;
		gcip-reserved-map = <0x80000000 0x0 0x1000>;
		
		/* System Integration */
		gxp,shareability = <0x20a40700>; /* SYSREG_AUR0 */
		pmu-aur-status = <0x15462304>;
		gxp-memory-per-core = <0 512>;
		gsa-device = <&gsa>;
	};
};
