// =====================================
// File: npu/gxp/mailbox-config.dtsi
// =====================================
// GXP Mailbox and Interrupt Configuration

/ {
	gxp {
		/* Interrupt Configuration */
		interrupts = 
			<GIC_SPI IRQ_MAILBOX_AURCORE02AP_ALIVE IRQ_TYPE_LEVEL_HIGH 0
			 GIC_SPI IRQ_MAILBOX_AURCORE12AP_ALIVE IRQ_TYPE_LEVEL_HIGH 0
			 GIC_SPI IRQ_MAILBOX_AURCORE22AP_ALIVE IRQ_TYPE_LEVEL_HIGH 0
			 GIC_SPI IRQ_MAILBOX_AURMCUNS02AP_ALIVE IRQ_TYPE_LEVEL_HIGH 0
			 GIC_SPI IRQ_MAILBOX_AURMCUNS12AP_ALIVE IRQ_TYPE_LEVEL_HIGH 0
			 GIC_SPI IRQ_AUR_WDOG_AP_IRQ_AUR IRQ_TYPE_LEVEL_HIGH 0>;
		
		/* TPU Interface */
		tpu-device = <&edgetpu>;
		gxp-tpu-mbx-offset = <0x0 0x50000>;
	};
};
