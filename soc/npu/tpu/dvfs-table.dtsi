// =====================================
// File: npu/tpu/dvfs-table.dtsi
// =====================================
// EdgeTPU DVFS Operating Points

/ {
	edgetpu {
		/* GCIP DVFS Table - 8 Operating Points */
		gcip-dvfs-table-size = <8 2>;
		gcip-dvfs-table = <
			/*  Freq(KHz)  Power(mW) */
			1119000        6725
			1119000        6725
			1066000        6329
			 845000        3404
			 712000        2900
			 627000        2018
			 455000        1492
			 226000         562
		>;
	};

	tpu_cooling: tpu-cooling {
		#cooling-cells = <2>;
	};
};
