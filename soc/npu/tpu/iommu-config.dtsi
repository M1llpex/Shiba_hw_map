// =====================================
// File: npu/tpu/iommu-config.dtsi
// =====================================
// EdgeTPU IOMMU Configuration

/ {
	edgetpu {
		iommus = <&sysmmu_tpu>;
		samsung,iommu-group = <&iommu_group_tpu>;
		memory-region = <&tpu_fw_reserved>;
	};
};
