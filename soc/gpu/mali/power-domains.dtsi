// =====================================
// File: gpu/mali/power-domains.dtsi
// =====================================
// Mali GPU Power Domain Configuration

/ {
	mali {
		/* Power Domains */
		power-domains = <&pd_g3d>, <&pd_embedded_g3d>;
		power-domain-names = "top", "cores";
		g3d_genpd_name = "pd-embedded_g3d";
		
		/* Power Management */
		gpu_pmu_status_reg_offset = <0x1C84>;
		gpu_pmu_status_local_pwr_mask = <0x1>; /* 0x1 << 0 */
		power_policy = "adaptive";
		
		/* Clock Management */
		gpu0_cmu_cal_id = <ACPM_DVFS_G3DL2>;
		gpu1_cmu_cal_id = <ACPM_DVFS_G3D>;
	};
};
