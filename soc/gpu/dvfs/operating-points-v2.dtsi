// =====================================
// File: gpu/dvfs/operating-points-v2.dtsi
// =====================================
// Mali GPU DVFS Table Version 2

/ {
	mali {
		/* DVFS v2 Table - 14 Operating Points */
		gpu_dvfs_table_size_v2 = <14 12>;
		gpu_dvfs_table_v2 = <
			/* GPU0   GPU1    Down  Up   Hys  INT    MIF     Little Mid  Big  MCU_Down MCU_Up */
			950000  940000   85   100   1    0      3172000  0      0    0    40       100
			900000  890000   85    97   1    0      3172000  0      0    0    40        60
			900000  850000   76    94   1    0      1716000  0      0    0    40        60
			900000  807000   85    96   2    0      1716000  0      0    0    30        60
			900000  723000   83    97   3    0      1352000  0      0    0    25        50
			749000  649000   78    95   3    0      1352000  0      0    0    25        40
			749000  580000   80    96   3    0      1352000  0      0    0    20        40
			659000  521000   76    95   3    0       845000  0      0    0    20        35
			659000  467000   72    95   3    0       845000  0      0    0    20        30
			531000  419000   67    94   2    0            0  0      0    0    15        30
			531000  376000   65    94   1    0            0  0      0    0    15        25
			430000  337000   60    94   1    0            0  0      0    0    12        20
			386000  302000   50    92   1    0            0  0      0    0     8        20
			160000  150000    0    90   1    0            0  0      0    0     0        20
		>;
	};
};
