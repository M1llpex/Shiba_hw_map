// =====================================
// File: performance/cpufreq/domain2-big.dtsi
// =====================================
// BIG Cluster Frequency Scaling

/ {
	exynos-acme {
		cpufreq_domain2: domain@2 {
			sibling-cpus = "8";
			cal-id = <ACPM_DVFS_CPUCL2>;
			dm-type = <DM_CPU_CL2>;

			min-freq = <500000>;
			max-freq = <2914000>;
			
			#cooling-cells = <2>;
			ect-coeff-index = <0>;
			tz-cooling-name = "BIG";
			skip-boot-pmqos;
			use-em-coeff;
			need-awake;
		};
	};
};
