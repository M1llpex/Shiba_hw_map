// =====================================
// File: performance/dsu-bci-constraints.dtsi
// =====================================
// DSU-BCI Constraint Table for Domain 0

/ {
	exynos-acme {
		cpufreq_domain0 {
			dsu-bci-constraint-table =
				/* CL0    DSU    BCI */
				< 2147000 2120000 1790000
				  2098000 2120000 1790000
				  2024000 2120000 1790000
				  1950000 2120000 1790000
				  1785000 1800000 1401000
				  1704000 1800000 1401000
				  1548000 1800000 1401000
				  1425000 1800000 1401000
				  1328000 1328000 1205000
				  1197000 1328000 1205000
				  1098000 1328000 1205000
				  955000  1328000 1205000
				  820000  1328000 1205000
				  610000  1328000 1205000
				  324000  970000  1050000 >;
		};
	};
};
